#include <Arduino.h>
#ifdef ESP32
#include <WiFi.h>
#include "src/ESPAsyncWebServer/AsyncTCP.h"
#elif defined(ESP8266)
#include <ESP8266WiFi.h>
#include <ESPAsyncTCP.h>
#endif
#include "SPIFFS.h"
#include "src/ESPAsyncWebServer/ESPAsyncWebServer.h"
#include "src/ESPAsyncWebServer/SPIFFSEditor.h"
#include "src/ThingSpeak/ThingSpeak.h"
#include <OpenTherm.h>

// API settings

const char* ssid = "SSID";
const char* password = "PASSWORD";
unsigned long myChannelNumber = CHN;
const char* myReadAPIKey = "TOKEN";
const char* myWriteAPIKey = "TOKEN";

// HW settings

const int mInPin = 21; //2 for Arduino, 4 for ESP8266 (D2), 21 for ESP32
const int mOutPin = 22; //4 for Arduino, 5 for ESP8266 (D1), 22 for ESP32

const int sInPin = 19; //3 for Arduino, 12 for ESP8266 (D6), 19 for ESP32
const int sOutPin = 23; //5 for Arduino, 13 for ESP8266 (D7), 23 for ESP32

// code

const char index_html[] PROGMEM = R"rawliteral(
<script type="text/javascript">var ipAddr="192.168.88.38"; var readToken="`READ_TOKEN`"; var channelId="`CHANNEL_ID`"; //ipAddr=0; readToken="XZRX9TUVV1OH7I6M"; channelId="1380393";</script><!DOCTYPE html><html lang="en"> <head> <meta charset="UTF-8"/> <meta name="viewport" content="width=device-width, initial-scale=1.0"/> <meta http-equiv="X-UA-Compatible" content="ie=edge"/> <title>Brush charts</title> <link href="../styles.css" rel="stylesheet"/> <script src="https://cdn.jsdelivr.net/npm/apexcharts"></script> <script src="../otgw-core.js" async></script> <style>.wrapr{padding-top: 20px; padding-left: 10px; padding-bottom: 20px; padding-right: 10px; background: #fff; border: 1px solid #ddd; box-shadow: 0 22px 35px -16px rgba(0, 0, 0, 0.1); max-width: 650px; margin: 35px auto;}#chart-line{position: relative; margin-top: -40px;}.center{display: flex; align-items: center; justify-content: center;}.label-column{white-space: nowrap; width: auto;}.switch{position: relative; display: inline-block; width: 40px; height: 24px;}.switch input{opacity: 0; width: 0; height: 0;}.slider{position: absolute; cursor: pointer; top: 0; left: 0; right: 0; bottom: 0; background-color: #ccc; -webkit-transition: 0.4s; transition: 0.4s;}.slider:before{position: absolute; content: ""; height: 16px; width: 16px; left: 4px; bottom: 4px; background-color: white; -webkit-transition: 0.4s; transition: 0.4s;}input:checked + .slider{background-color: #2196f3;}input:focus + .slider{box-shadow: 0 0 1px #2196f3;}input:checked + .slider:before{-webkit-transform: translateX(16px); -ms-transform: translateX(16px); transform: translateX(16px);}/* Rounded sliders */ .slider.round{border-radius: 24px;}.slider.round:before{border-radius: 50%;}</style> </head> <body> <div class="wrapr"> <table style="width: 100%; background-color: aquamarine" id="idd"> <tr> <td class="label-column">From</td><td style="width: auto"> <input type="datetime-local" id="date-from"/> </td><td style="width: 100%"></td></tr><tr> <td class="label-column">To</td><td style="width: auto"> <input type="datetime-local" id="date-to"/> </td><td style="width: 100%"></td></tr><tr> <td class="label-column">Heating target, &#x00B0;C</td><td style="width: auto"></td><td class="label-column">Heating current, &#x00B0;C</td></tr><tr> <td class="label-column">Hot water target, &#x00B0;C</td><td style="width: auto"></td><td class="label-column">Hot water current, &#x00B0;C</td></tr><tr> <td class="label-column">Heating enable</td><td style="width: auto"></td><td class="label-column"> <label class="switch"> <input type="checkbox" checked id="heatingEnableInput"/> <span class="slider round"></span> </label> </td></tr></table> </div><div class="wrapr center" style="height: 500px" id="chart-container"> <div id="waiting-indicator" style="text-align: center; margin: 0 auto">LOADING...</div><div id="chart-flame"></div><div id="chart-line2"></div><div id="chart-line"></div></div><textarea class="wrapr center" style="height: 150px; width: 100%" id="commands-log"></textarea> </body></html>
)rawliteral";

const int favico_ico_length = 4286;
const byte favico_ico[] PROGMEM = {0x00, 0x00, 0x01, 0x00, 0x01, 0x00, 0x20, 0x20, 0x00, 0x00, 0x01, 0x00, 0x20,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 0x00, 0x00};

AsyncWebServer server(80);
AsyncWebSocket ws("/ws");

OpenTherm mOT(mInPin, mOutPin);
OpenTherm sOT(sInPin, sOutPin, true);

bool _heatingDisable = false;

void ICACHE_RAM_ATTR mHandleInterrupt() {
  mOT.handleInterrupt();
}

void ICACHE_RAM_ATTR sHandleInterrupt() {
  sOT.handleInterrupt();
}

void notifyClients(String s) {
  ws.textAll(s);
}


void processRequest(unsigned long request, OpenThermResponseStatus status) {
  if (_heatingDisable)
    return;

  String masterRequest = "T" + String(request, HEX);
  notifyClients(masterRequest);
  Serial.println(masterRequest);  //master/thermostat request
  unsigned long response = mOT.sendRequest(request);
  if (response) {
    String slaveResponse = "B" + String(response, HEX);
    Serial.println(slaveResponse); //slave/boiler response
    notifyClients(slaveResponse);
    sOT.sendResponse(response);
  }
}



const char* PARAM_MESSAGE = "message";

WiFiClient  client;

bool ledState = false;

void handleWebSocketMessage(void *arg, uint8_t *data, size_t len) {
  AwsFrameInfo *info = (AwsFrameInfo*)arg;
  if (info->final && info->index == 0 && info->len == len && info->opcode == WS_TEXT) {
    data[len] = 0;
    if (strcmp((char*)data, "toggle") == 0) {
      ledState = !ledState;
      //notifyClients();
    }
  }
}

void onEvent(AsyncWebSocket *server, AsyncWebSocketClient *client, AwsEventType type,
             void *arg, uint8_t *data, size_t len) {
  switch (type) {
    case WS_EVT_CONNECT:
      Serial.printf("WebSocket client #%u connected from %s\n", client->id(), client->remoteIP().toString().c_str());
      break;
    case WS_EVT_DISCONNECT:
      Serial.printf("WebSocket client #%u disconnected\n", client->id());
      break;
    case WS_EVT_DATA:
      handleWebSocketMessage(arg, data, len);
      break;
    case WS_EVT_PONG:
    case WS_EVT_ERROR:
      break;
  }
}

void initWebSocket() {
  ws.onEvent(onEvent);
  server.addHandler(&ws);
}

String processor(const String& var) {
  Serial.println(var);
  if (var == "STATE") {
    if (ledState) {
      return "ON";
    }
    else {
      return "OFF";
    }
  }
}


void notFound(AsyncWebServerRequest *request) {
  request->send(404, "text/plain", "Not found " + request->url());
  Serial.println("Not found " + request->url());
}

String htmlVarProcessor(const String& var)
{
  if (var == "IP_ADDR")
    return WiFi.localIP().toString();

  if (var == "READ_TOKEN")
    return myReadAPIKey;

  if (var == "CHANNEL_ID")
    return String(myChannelNumber);

  return String();
}


void setup() {
  Serial.begin(9600);
  Serial.println("WiFi...");
  WiFi.mode(WIFI_STA);
  WiFi.begin(ssid, password);
  if (WiFi.waitForConnectResult() != WL_CONNECTED) {
    Serial.printf("WiFi Failed!\n");
    return;
  }

  Serial.println("SPIFFS...");
  if (!SPIFFS.begin(true)) {
    Serial.println("An Error has occurred while mounting SPIFFS");
    return;
  }

  Serial.print("IP Address: ");
  Serial.println(WiFi.localIP());

  server.on("/", HTTP_GET, [](AsyncWebServerRequest * request) {
    request->send(SPIFFS, "/html/index.html", String(), false, htmlVarProcessor);
    //request->send_P(200, "text/html", index_html, htmlVarProcessor);
  });

  server.on("/heating-false", HTTP_GET, [](AsyncWebServerRequest * request) {
    Serial.println("Heating disable override");
    request->send(200, "text/plain", "OK: heating off");
  });

  server.on("/heating-true", HTTP_GET, [](AsyncWebServerRequest * request) {
    Serial.println("Heating enable");
    request->send(200, "text/plain", "OK: heating on");
  });

  server.on("/otgw-core.js", HTTP_GET, [](AsyncWebServerRequest * request) {
    AsyncWebServerResponse* response = request->beginResponse(SPIFFS, "/otgw-core.js");
    response->addHeader("cache-control", "max-age=7776000");
    request->send(response);
  });

  server.on("/styles.css", HTTP_GET, [](AsyncWebServerRequest * request) {
    AsyncWebServerResponse* response = request->beginResponse(SPIFFS, "/styles.css");
    response->addHeader("cache-control", "max-age=7776000");
    request->send(response);
  });

  server.on("/favicon.ico", HTTP_GET, [](AsyncWebServerRequest * request) {
    //AsyncWebServerResponse* response = request->beginResponse(SPIFFS, "/favicon.ico");
    AsyncWebServerResponse* response = request->beginResponse_P(200, "image/x-icon", favico_ico, favico_ico_length);
    response->addHeader("cache-control", "max-age=7776000");
    request->send(response);
  });

  // Send a GET request to <IP>/get?message=<message>
  server.on("/get", HTTP_GET, [] (AsyncWebServerRequest * request) {
    String message;
    if (request->hasParam(PARAM_MESSAGE)) {
      message = request->getParam(PARAM_MESSAGE)->value();
    } else {
      message = "No message sent";
    }
    request->send(200, "text/plain", "Hello, GET: " + message);
  });

  // Send a POST request to <IP>/post with a form field message set to <message>
  server.on("/post", HTTP_POST, [](AsyncWebServerRequest * request) {
    String message;
    if (request->hasParam(PARAM_MESSAGE, true)) {
      message = request->getParam(PARAM_MESSAGE, true)->value();
    } else {
      message = "No message sent";
    }
    request->send(200, "text/plain", "Hello, POST: " + message);
  });

  server.onNotFound(notFound);

  server.addHandler(new SPIFFSEditor(SPIFFS, "open", "therm"));
  server.begin();

  ThingSpeak.begin(client);

  initWebSocket();

  mOT.begin(mHandleInterrupt);
  sOT.begin(sHandleInterrupt, processRequest);

  Serial.println("Setup done");
}

void loop() {
  sOT.process();
  ws.cleanupClients();
  //notifyClients();
  //delay(10000);
  return;
  // set the fields with the values
  /*ThingSpeak.setField(1, 47.9f);
    ThingSpeak.setField(2, 46);
    ThingSpeak.setField(3, 74);
    ThingSpeak.setField(4, true);*/
  String str;
  for (int i = 0; i < 255; ++i)
    str += 's';
  ThingSpeak.setField(5, str);
  // write to the ThingSpeak channel
  int x = ThingSpeak.writeFields(myChannelNumber, myWriteAPIKey);
  if (x == 200) {
    Serial.println("Channel update successful.");
  }
  else {
    Serial.println("Problem updating channel. HTTP error code " + String(x));
  }

  delay(20000);
}
